## firmware/SightLatchS3USB/main/Kconfig.projbuild
```kconfig
menu "SightLatch experimental USB"
config SIGHTLATCH_PAIR_GPIO
    int "Physical pairing / stop button GPIO (board must be verified)"
    range 0 48
    default 0
    help
        Default is BOOT on common S3 devkits, pressed only AFTER boot.
        Confirm the board schematic. Do not use USB GPIO19/20 or flash pins.
        Any press stops HID immediately; hold three seconds to replace the session.
config SIGHTLATCH_ALLOW_UART_PAIRING
    bool "Enable temporary UART pairing code for unlabeled development boards"
    default n
    help
        Development only. Needs a second trusted device attached to UART.
        This is NOT iPhone-only setup. Do not capture UART output to logs.
endmenu
```

## firmware/SightLatchS3USB/sdkconfig.defaults
```kconfig
CONFIG_IDF_TARGET="esp32s3"
CONFIG_ESPTOOLPY_FLASHSIZE_4MB=y
CONFIG_PARTITION_TABLE_CUSTOM=y
CONFIG_PARTITION_TABLE_CUSTOM_FILENAME="partitions.csv"
CONFIG_ESP_CONSOLE_UART_DEFAULT=y
# CONFIG_ESP_CONSOLE_USB_SERIAL_JTAG is not set
CONFIG_TINYUSB_NET_MODE_NCM=y
CONFIG_TINYUSB_HID_COUNT=1
CONFIG_TINYUSB_CDC_COUNT=0
# CONFIG_TINYUSB_MSC_ENABLED is not set
# CONFIG_ESP_PROTOCOMM_SUPPORT_SECURITY_VERSION_0 is not set
# CONFIG_ESP_PROTOCOMM_SUPPORT_SECURITY_VERSION_1 is not set
CONFIG_ESP_PROTOCOMM_SUPPORT_SECURITY_VERSION_2=y
CONFIG_LOG_DEFAULT_LEVEL_WARN=y
CONFIG_LOG_MAXIMUM_LEVEL_WARN=y
CONFIG_ESP_MAIN_TASK_STACK_SIZE=12288
```
